// SPDX-License-Identifier: (GPL-2.0-or-later OR BSD-3-Clause)
/*
 * Copyright (C) STMicroelectronics 2024 - All Rights Reserved
 * Author: Lionel Vitte <lionel.vitte@st.com> for STMicroelectronics.
 */

#include <stm32mp157f-dk2.dts>

/ {
        model = "STMicroelectronics STM32MP157F-DK2 Discovery Board for RT";
        compatible = "st,stm32mp157f-dk2-rt", "st,stm32mp157f-dk2", "st,stm32mp157";

        cpu0-opp-table  {
                /delete-node/ opp-400000000;
                /delete-node/ opp-800000000;
                opp-650000000 {
                        opp-supported-hw = <0x03>;
                };
        };
};

&iwdg1 {
        status = "disabled";
};
