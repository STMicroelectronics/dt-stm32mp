// SPDX-License-Identifier: (GPL-2.0-or-later OR BSD-3-Clause)
/*
 * Copyright (C) STMicroelectronics 2024 - All Rights Reserved
 * Author: Lionel Vitte <lionel.vitte@st.com> for STMicroelectronics.
 */

#include <stm32mp257f-ev1-fw-config.dts>

