// SPDX-License-Identifier: (GPL-2.0-only OR BSD-3-Clause)
/*
 * Copyright (C) STMicroelectronics 2025 - All Rights Reserved
 * Author: Alexandre Torgue <alexandre.torgue@foss.st.com> for STMicroelectronics.
 */

/dts-v1/;

#include "stm32mp135f-dk.dts"

/ {
	model = "STMicroelectronics STM32MP135F-DK-OSTL Discovery Board";
	compatible = "st,stm32mp135f-ostl", "st,stm32mp135f-dk", "st,stm32mp135";
};
