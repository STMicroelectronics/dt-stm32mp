// SPDX-License-Identifier: (GPL-2.0-or-later OR BSD-3-Clause)
/*
 * Copyright (C) STMicroelectronics 2025 - All Rights Reserved
 * Author: Gatien Chevallier <gatien.chevallier@foss.st.com> for STMicroelectronics.
 */

#include <stm32mp257f-dk.dts>

/ {
	model = "STMicroelectronics STM32MP257F-DK Evaluation Board for RT performance";
	compatible = "st,stm32mp257f-dk-perf-rt", "st,stm32mp257f-dk-rt", "st,stm32mp257f-dk", "st,stm32mp257";
};

&iwdg1 {
	status = "disabled";
};
