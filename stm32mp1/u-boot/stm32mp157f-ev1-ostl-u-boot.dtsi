// SPDX-License-Identifier: (GPL-2.0-only OR BSD-3-Clause)
/*
 * Copyright (C) 2025, STMicroelectronics - All Rights Reserved
 */

#include "stm32mp157c-ev1-u-boot.dtsi"

/ {
	model = "STMicroelectronics STM32MP157F OSTL eval daughter on eval mother";
	compatible = "st,stm32mp157f-ev1-ostl", "st,stm32mp157f-ed1", "st,stm32mp157";

	aliases {
		i2c3 = &i2c2;
	};

};
