// SPDX-License-Identifier: (GPL-2.0-only OR BSD-3-Clause)
/*
 * Copyright (c) 2025, STMicroelectronics - All Rights Reserved
 */

#include "stm32mp23-fw-config.dtsi"
#include "stm32mp235f-dk-cm33tdcid-ostl-fw-config.dtsi"
