// SPDX-License-Identifier: (GPL-2.0-only OR BSD-3-Clause)
/*
 * Copyright (C) 2025, STMicroelectronics - All Rights Reserved
 */

#include "stm32mp157f-dk2-u-boot.dtsi"

/ {

	aliases {
		/delete-property/i2c3;
	};
};

&usbotg_hs {
	phys = <&usbphyc_port1 0>;
	phy-names = "usb2-phy";
	u-boot,force-b-session-valid;
	dr_mode = "peripheral";
	status = "okay";
};
