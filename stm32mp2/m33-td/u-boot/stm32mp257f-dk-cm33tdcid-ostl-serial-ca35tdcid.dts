// SPDX-License-Identifier: (GPL-2.0-only OR BSD-3-Clause)
/*
 * Copyright (C) STMicroelectronics 2025 - All Rights Reserved
 * Author: Raphaël Gallais-Pou <raphael.gallais-pou@foss.st.com> for STMicroelectronics.
 */

#include "stm32mp257f-dk.dts"
