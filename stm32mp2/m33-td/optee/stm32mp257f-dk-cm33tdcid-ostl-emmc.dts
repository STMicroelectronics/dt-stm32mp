// SPDX-License-Identifier: (GPL-2.0-only OR BSD-3-Clause)
/*
 * Copyright (C) STMicroelectronics 2025 - All Rights Reserved
 * Author: Raphaël Gallais-Pou <raphael.gallais-pou@foss.st.com> for STMicroelectronics.
 */

/dts-v1/;

#include "stm32mp257f-dk-cm33tdcid-ostl.dts"

/ {
	model = "STMicroelectronics STM32MP257F-DK EMMC CM33TDCID OSTL Discovery Board";
	compatible = "st,stm32mp257f-dk-cm33tdcid-ostl-emmc", "st,stm32mp257f-dk", "st,stm32mp257";
};
